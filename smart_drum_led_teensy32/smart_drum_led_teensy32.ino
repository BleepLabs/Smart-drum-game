#include <FastLED.h>
#include <MIDI.h>

//MIDI_CREATE_INSTANCE(HardwareSerial, Serial1, MIDI);
MIDI_CREATE_DEFAULT_INSTANCE();


byte number[16][8][8] = {
  {
    {0, 0, 0, 0, 0, 0, 0, 0},
    {0, 0, 1, 1, 1, 1, 0, 0},
    {0, 1, 0, 0, 0, 1, 1, 0},
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    {0, 0, 0, 0, 0, 0, 0, 0}
  },
  {
    {0, 0, 0, 0, 0, 0, 0, 0},
    {0, 0, 1, 1, 1, 0, 0, 0},
    {0, 1, 0, 1, 1, 0, 0, 0},
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    {0, 0, 0, 0, 0, 0, 0, 0}
  },
  {
    {0, 0, 0, 0, 0, 0, 0, 0},
    {0, 0, 1, 1, 1, 1, 0, 0},
    {0, 1, 0, 0, 0, 1, 1, 0},
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    {0, 0, 0, 0, 0, 0, 0, 0},
  },
  {
    {0, 0, 0, 0, 0, 0, 0, 0},
    {0, 0, 1, 1, 1, 1, 0, 0},
    {0, 1, 0, 0, 0, 1, 1, 0},
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    {0, 0, 0, 0, 0, 0, 0, 0}
  },
  {
    {0, 0, 0, 0, 0, 0, 0, 0},
    {0, 1, 0, 0, 0, 1, 1, 0},
    {0, 1, 0, 0, 0, 1, 1, 0},
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    {0, 0, 0, 0, 0, 0, 0, 0}
  },
  {
    {0, 0, 0, 0, 0, 0, 0, 0},
    {0, 1, 1, 1, 1, 1, 1, 0},
    {0, 1, 0, 0, 0, 0, 0, 0},
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    {0, 0, 0, 0, 0, 0, 0, 0}
  },
  {
    {0, 0, 0, 0, 0, 0, 0, 0},
    {0, 0, 1, 1, 1, 1, 1, 0},
    {0, 1, 1, 0, 0, 0, 1, 0},
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    {0, 0, 0, 0, 0, 0, 0, 0}
  },
  {
    {0, 0, 0, 0, 0, 0, 0, 0},
    {0, 1, 1, 1, 1, 1, 1, 0},
    {0, 0, 0, 0, 0, 1, 1, 0},
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    {0, 0, 0, 0, 0, 0, 0, 0}
  },
  {
    {0, 0, 0, 0, 0, 0, 0, 0},
    {0, 0, 1, 1, 1, 1, 0, 0},
    {0, 1, 0, 0, 0, 1, 1, 0},
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    {0, 0, 0, 0, 0, 0, 0, 0}
  },
  { {0, 0, 0, 0, 0, 0, 0, 0},
    {0, 1, 1, 1, 1, 1, 0, 0},
    {0, 1, 0, 0, 0, 1, 1, 0},
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    {0, 0, 0, 0, 0, 0, 0, 0}
  },
  {
    {0, 0, 0, 0, 0, 0, 0, 0},    /////happy
    {0, 1, 2, 0, 0, 1, 2, 0},
    {0, 1, 1, 0, 0, 1, 1, 0},
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    {0, 0, 0, 0, 0, 0, 0, 0}
  },
  {
    {0, 0, 0, 0, 0, 0, 0, 0},   /////sad
    {0, 1, 1, 0, 0, 1, 1, 0},
    {0, 2, 1, 0, 0, 2, 1, 0},
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    {0, 0, 0, 0, 0, 0, 0, 0}
  }

};

byte text[20][8][32] = {
  {
    {0, 0, 0, 1, 0, 0, 0, 0, 1, 1, 1, 0, 0, 1, 1, 0, 0, 1, 1, 1, 0, 1, 1, 1, 1, 0, 1, 0, 0, 1, 0, 0},
    {0, 0, 0, 1, 0, 0, 0, 0, 0, 1, 0, 0, 1, 0, 0, 1, 0, 0, 1, 0, 0, 1, 0, 0, 0, 0, 1, 0, 0, 1, 0, 0},
    {0, 0, 0, 1, 0, 0, 0, 0, 0, 1, 0, 0, 1, 0, 0, 0, 0, 0, 1, 0, 0, 1, 0, 0, 0, 0, 1, 1, 0, 1, 0, 0},
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    {0, 0, 0, 1, 1, 1, 1, 0, 1, 1, 1, 0, 0, 1, 1, 0, 0, 0, 1, 0, 0, 1, 1, 1, 1, 0, 1, 0, 0, 1, 0, 0}
  },

  {
    {0, 0, 0, 0, 0, 1, 1, 1, 0, 0, 1, 0, 0, 0, 1, 0, 0, 1, 1, 1, 0, 0, 1, 0, 0, 0, 1, 0, 1, 0, 0, 0},
    {0, 0, 0, 0, 1, 0, 0, 0, 1, 0, 1, 0, 0, 1, 0, 0, 1, 0, 0, 0, 1, 0, 1, 0, 0, 0, 1, 0, 1, 0, 0, 0},
    {0, 0, 0, 0, 1, 0, 0, 0, 1, 0, 1, 0, 1, 0, 0, 0, 1, 0, 0, 0, 1, 0, 1, 0, 0, 0, 1, 0, 1, 0, 0, 0},
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    {0, 0, 0, 0, 0, 1, 1, 1, 0, 0, 1, 0, 0, 0, 1, 0, 1, 0, 0, 0, 1, 0, 0, 0, 1, 0, 0, 0, 1, 0, 0, 0}
  },
  {

    {1, 1, 1, 0, 0, 1, 1, 1, 0, 0, 1, 1, 1, 1, 0, 0, 1, 1, 0, 0, 0, 1, 1, 0, 0, 0, 0, 0, 0, 1, 1, 0},
    {1, 0, 0, 1, 0, 1, 0, 0, 1, 0, 1, 0, 0, 0, 0, 1, 0, 0, 1, 0, 1, 0, 0, 1, 0, 0, 0, 0, 1, 0, 0, 1},
    {1, 0, 0, 1, 0, 1, 0, 0, 1, 0, 1, 0, 0, 0, 0, 1, 0, 0, 0, 0, 1, 0, 0, 0, 0, 0, 0, 0, 1, 0, 0, 1},
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    {1, 0, 0, 0, 0, 1, 0, 0, 1, 0, 1, 1, 1, 1, 0, 0, 1, 1, 0, 0, 0, 1, 1, 0, 0, 0, 0, 0, 1, 0, 0, 1}
  },
  {
    {0, 0, 1, 1, 1, 0, 0, 1, 0, 0, 1, 0, 1, 1, 1, 0, 1, 1, 1, 0, 0, 1, 1, 0, 0, 1, 0, 0, 1, 0, 0, 0},
    {0, 0, 1, 0, 0, 1, 0, 1, 0, 0, 1, 0, 0, 1, 0, 0, 0, 1, 0, 0, 1, 0, 0, 1, 0, 1, 0, 0, 1, 0, 0, 0},
    {0, 0, 1, 0, 0, 1, 0, 1, 0, 0, 1, 0, 0, 1, 0, 0, 0, 1, 0, 0, 1, 0, 0, 1, 0, 1, 1, 0, 1, 0, 0, 0},
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    {0, 0, 1, 1, 1, 0, 0, 0, 1, 1, 0, 0, 0, 1, 0, 0, 0, 1, 0, 0, 0, 1, 1, 0, 0, 1, 0, 0, 1, 0, 0, 0}
  },
  {
    {1, 1, 1, 1, 0, 0, 1, 1, 1, 1, 0, 0, 1, 1, 0, 0, 1, 1, 1, 0, 0, 1, 0, 0, 0, 1, 0, 0, 1, 1, 1, 0},
    {1, 0, 0, 0, 1, 0, 1, 0, 0, 0, 0, 1, 0, 0, 1, 0, 1, 0, 0, 1, 0, 1, 0, 0, 0, 1, 0, 1, 0, 0, 0, 1},
    {1, 0, 0, 0, 1, 0, 1, 0, 0, 0, 0, 1, 0, 0, 1, 0, 1, 0, 0, 1, 0, 1, 0, 0, 0, 1, 0, 0, 0, 0, 0, 1},
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    {1, 0, 0, 0, 1, 0, 1, 1, 1, 1, 0, 1, 0, 0, 1, 0, 1, 1, 1, 0, 0, 0, 0, 1, 0, 0, 0, 0, 0, 1, 0, 0}
  },
  {
    {0, 0, 0, 0, 0, 1, 1, 1, 0, 0, 0, 1, 1, 1, 0, 0, 0, 1, 1, 1, 0, 0, 1, 0, 0, 0, 0, 0, 1, 0, 0, 0},
    {0, 0, 0, 0, 1, 0, 0, 0, 1, 0, 1, 0, 0, 0, 1, 0, 1, 0, 0, 0, 1, 0, 1, 0, 0, 0, 0, 0, 1, 0, 0, 0},
    {0, 0, 0, 0, 1, 0, 0, 0, 0, 0, 1, 0, 0, 0, 1, 0, 1, 0, 0, 0, 1, 0, 1, 0, 0, 0, 0, 0, 1, 0, 0, 0},
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    {0, 0, 0, 0, 0, 1, 1, 1, 0, 0, 0, 1, 1, 1, 0, 0, 0, 1, 1, 1, 0, 0, 1, 1, 1, 1, 0, 0, 1, 0, 0, 0}
  },
  {
    {0, 1, 1, 1, 0, 0, 1, 1, 1, 1, 0, 0, 1, 1, 1, 1, 0, 0, 1, 1, 1, 0, 0, 1, 1, 1, 1, 1, 0, 1, 0, 1},
    {1, 0, 0, 0, 1, 0, 1, 0, 0, 0, 1, 0, 1, 0, 0, 0, 0, 1, 0, 0, 0, 1, 0, 0, 0, 1, 0, 0, 0, 1, 0, 1},
    {1, 0, 0, 0, 0, 0, 1, 0, 0, 0, 1, 0, 1, 0, 0, 0, 0, 1, 0, 0, 0, 1, 0, 0, 0, 1, 0, 0, 0, 1, 0, 1},
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    {0, 1, 1, 1, 0, 0, 1, 0, 0, 0, 1, 0, 1, 1, 1, 1, 0, 1, 0, 0, 0, 1, 0, 0, 0, 1, 0, 0, 0, 1, 0, 1}
  },
  { {1, 0, 0, 0, 0, 0, 0, 0, 1, 0, 0, 1, 1, 1, 0, 0, 1, 0, 0, 0, 0, 0, 0, 0, 1, 0, 0, 1, 0, 2, 0, 1},
    {1, 2, 0, 0, 0, 0, 0, 2, 1, 0, 1, 2, 0, 0, 1, 0, 1, 2, 0, 0, 0, 0, 0, 2, 1, 0, 0, 1, 0, 2, 0, 1},
    {1, 1, 0, 0, 1, 0, 0, 1, 1, 0, 1, 2, 0, 0, 1, 0, 1, 1, 0, 0, 1, 0, 0, 1, 1, 0, 0, 1, 0, 2, 0, 1},
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    {0, 0, 1, 0, 0, 0, 1, 0, 0, 0, 0, 1, 1, 1, 0, 0, 0, 0, 1, 0, 0, 0, 1, 0, 0, 0, 0, 1, 0, 2, 0, 1}
  },
  {
    {0, 0, 0, 1, 1, 0, 0, 0, 1, 1, 0, 0, 0, 1, 1, 0, 0, 1, 1, 1, 0, 0, 1, 1, 1, 1, 0, 0, 0, 0, 0, 0},
    {0, 0, 1, 0, 0, 1, 0, 1, 0, 0, 1, 0, 1, 0, 0, 1, 0, 1, 0, 0, 1, 0, 1, 0, 0, 0, 0, 0, 0, 0, 0, 0},
    {0, 0, 1, 0, 0, 0, 0, 1, 0, 0, 0, 0, 1, 0, 0, 1, 0, 1, 0, 0, 1, 0, 1, 0, 0, 0, 0, 1, 1, 1, 0, 0},
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    {0, 0, 0, 1, 1, 0, 0, 0, 1, 1, 0, 0, 0, 1, 1, 0, 0, 1, 0, 0, 1, 0, 1, 1, 1, 1, 0, 0, 0, 0, 0, 0}
  },
  {
    {0, 0, 0, 0, 1, 0, 0, 0, 0, 1, 1, 1, 1, 0, 1, 0, 0, 0, 1, 0, 1, 1, 1, 1, 0, 1, 0, 0, 0, 0, 0, 0},
    {0, 0, 0, 0, 1, 0, 0, 0, 0, 1, 0, 0, 0, 0, 1, 0, 0, 0, 1, 0, 1, 0, 0, 0, 0, 1, 0, 0, 0, 0, 0, 0},
    {0, 0, 0, 0, 1, 0, 0, 0, 0, 1, 0, 0, 0, 0, 1, 0, 0, 0, 1, 0, 1, 0, 0, 0, 0, 1, 0, 0, 0, 0, 0, 0},
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    {0, 0, 0, 0, 1, 1, 1, 1, 0, 1, 1, 1, 1, 0, 0, 0, 1, 0, 0, 0, 1, 1, 1, 1, 0, 1, 1, 1, 1, 0, 0, 0}
  },
  {
    {0, 0, 0, 0, 1, 1, 1, 1, 0, 1, 1, 1, 0, 1, 0, 0, 1, 0, 0, 1, 1, 0, 0, 1, 0, 0, 0, 0, 0, 0, 0, 0},
    {0, 0, 0, 0, 1, 0, 0, 0, 0, 0, 1, 0, 0, 1, 0, 0, 1, 0, 1, 0, 0, 1, 0, 1, 0, 0, 0, 0, 0, 0, 0, 0},
    {0, 0, 0, 0, 1, 0, 0, 0, 0, 0, 1, 0, 0, 1, 1, 0, 1, 0, 1, 0, 0, 1, 0, 1, 0, 0, 0, 0, 0, 0, 0, 0},
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    {0, 0, 0, 0, 1, 0, 0, 0, 0, 1, 1, 1, 0, 1, 0, 0, 1, 0, 1, 0, 0, 1, 0, 1, 1, 1, 1, 0, 0, 0, 0, 0}
  },
  {
    {0, 0, 0, 0, 0, 1, 1, 1, 1, 1, 1, 1, 1, 0, 0, 0, 0, 0, 0, 1, 1, 1, 1, 1, 1, 1, 1, 0, 0, 0, 0, 0},
    {0, 0, 0, 0, 1, 0, 0, 0, 0, 0, 0, 0, 0, 0, 0, 0, 0, 0, 1, 0, 0, 0, 0, 0, 0, 0, 0, 1, 0, 0, 0, 0},
    {0, 0, 0, 0, 1, 0, 0, 0, 0, 0, 0, 0, 0, 0, 0, 0, 0, 0, 1, 0, 0, 0, 0, 0, 0, 0, 0, 1, 0, 0, 0, 0},
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    {0, 0, 0, 0, 0, 1, 1, 1, 1, 1, 1, 1, 1, 0, 0, 0, 0, 0, 0, 1, 1, 1, 1, 1, 1, 1, 1, 0, 0, 0, 0, 0}
  },
  {
    {0, 0, 1, 1, 1, 1, 0, 0, 0, 0, 1, 1, 1, 1, 0, 1, 0, 0, 0, 0, 0, 1, 1, 0, 0, 1, 0, 0, 0, 1, 0, 0},
    {0, 1, 0, 0, 0, 1, 1, 0, 0, 0, 1, 0, 0, 1, 0, 1, 0, 0, 0, 0, 1, 0, 0, 1, 0, 1, 0, 0, 0, 1, 0, 0},
    {0, 0, 0, 0, 0, 1, 1, 0, 0, 0, 1, 0, 0, 1, 0, 1, 0, 0, 0, 0, 1, 0, 0, 1, 0, 1, 0, 0, 0, 1, 0, 0},
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    {0, 1, 1, 1, 1, 1, 1, 0, 0, 0, 1, 0, 0, 0, 0, 1, 1, 1, 1, 0, 1, 0, 0, 1, 0, 0, 0, 1, 0, 0, 0, 0}
  },
  {
    {0, 0, 1, 1, 1, 0, 0, 0, 0, 0, 1, 1, 1, 1, 0, 1, 0, 0, 0, 0, 0, 1, 1, 0, 0, 1, 0, 0, 0, 1, 0, 0},
    {0, 1, 0, 1, 1, 0, 0, 0, 0, 0, 1, 0, 0, 1, 0, 1, 0, 0, 0, 0, 1, 0, 0, 1, 0, 1, 0, 0, 0, 1, 0, 0},
    {0, 0, 0, 1, 1, 0, 0, 0, 0, 0, 1, 0, 0, 1, 0, 1, 0, 0, 0, 0, 1, 0, 0, 1, 0, 1, 0, 0, 0, 1, 0, 0},
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    {0, 1, 1, 1, 1, 1, 1, 0, 0, 0, 1, 0, 0, 0, 0, 1, 1, 1, 1, 0, 1, 0, 0, 1, 0, 0, 0, 1, 0, 0, 0, 0}
  },
  {
    {0, 0, 0, 1, 1, 1, 0, 0, 0, 0, 0, 0, 0, 0, 0, 0, 0, 0, 0, 0, 0, 0, 0, 0, 0, 0, 0, 0, 0, 0, 0, 0}, //aarow pointing left
    {0, 0, 1, 1, 1, 0, 0, 0, 0, 0, 0, 0, 0, 0, 0, 0, 0, 0, 0, 0, 0, 0, 0, 0, 0, 0, 0, 0, 0, 0, 0, 0},
    {0, 1, 1, 1, 0, 0, 0, 0, 0, 0, 0, 0, 0, 0, 0, 0, 0, 0, 0, 0, 0, 0, 0, 0, 0, 0, 0, 0, 0, 0, 0, 0},
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    {0, 0, 0, 1, 1, 1, 0, 0, 0, 0, 0, 0, 0, 0, 0, 0, 0, 0, 0, 0, 0, 0, 0, 0, 0, 0, 0, 0, 0, 0, 0, 0}

  },
  {
    {0, 0, 0, 0, 0, 0, 0, 1, 1, 0, 0, 0, 0, 0, 0, 1, 1, 0, 0, 0, 0, 0, 0, 1, 1, 0, 0, 0, 0, 0, 0, 0},
    {0, 0, 0, 0, 0, 0, 1, 0, 0, 1, 0, 0, 0, 0, 1, 0, 0, 1, 0, 0, 0, 0, 1, 0, 0, 1, 0, 0, 0, 0, 0, 0},
    {0, 0, 0, 0, 0, 1, 0, 0, 0, 0, 1, 0, 0, 1, 0, 0, 0, 0, 1, 0, 0, 1, 0, 0, 0, 0, 1, 0, 0, 0, 0, 0},
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    {0, 0, 0, 0, 0, 0, 0, 1, 1, 0, 0, 0, 0, 0, 0, 1, 1, 0, 0, 0, 0, 0, 0, 1, 1, 0, 0, 0, 0, 0, 0, 0}
  },
  {

    {0, 0, 0, 0, 0, 0, 0, 0, 0, 0, 0, 0, 0, 0, 0, 0, 0, 0, 0, 0, 0, 0, 0, 0, 0, 0, 1, 1, 1, 0, 0, 0}, //aarrpw pointing right
    {0, 0, 0, 0, 0, 0, 0, 0, 0, 0, 0, 0, 0, 0, 0, 0, 0, 0, 0, 0, 0, 0, 0, 0, 0, 0, 0, 1, 1, 1, 0, 0},
    {0, 0, 0, 0, 0, 0, 0, 0, 0, 0, 0, 0, 0, 0, 0, 0, 0, 0, 0, 0, 0, 0, 0, 0, 0, 0, 0, 0, 1, 1, 1, 0},
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    {0, 0, 0, 0, 0, 0, 0, 0, 0, 0, 0, 0, 0, 0, 0, 0, 0, 0, 0, 0, 0, 0, 0, 0, 0, 0, 1, 1, 1, 0, 0, 0}


  }

};


byte curve[257] = {0, 0, 0, 0, 0, 0, 0, 0, 0, 0, 0, 1, 1,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 254, 255};

#define LED_PIN  6

#define COLOR_ORDER GRB
#define CHIPSET     WS2812B

#define BRIGHTNESS 128

#define PLAYER_NUM 0

#define LISTEN 0
#define OKAY 1
#define PRESS 2
#define BUTTON 3
#define READY 4
#define COOL 5
#define GREAT 6
#define WOW 7
#define SCORE 8
#define LEVEL 9
#define FINAL 10
#define GO 11
#define TWO_PLAY 12
#define ONE_PLAY 13
#define ARROW 14
#define QUESTION_MARK 15

#define BUTT_NUM 9


byte text_color[20] = {10, 20, 30, 50, 70, 80, 90};

byte button_led_state[4][BUTT_NUM + 1];
byte button_led_output[4][BUTT_NUM + 1];

uint32_t cm, prev[10], lerpp[20];
byte mode[4] = {0, 3, 3};
// Params for width and height


// Param for different pixel layouts
const bool    kMatrixSerpentineLayout = true;
byte tog;
byte last_frame[256][256][256];

const uint8_t kMatrixWidth = 8;
const uint8_t kMatrixHeight = 32;

#define NUM_LEDS (kMatrixWidth * kMatrixHeight)
//CRGB leds_plus_safety_pixel[ NUM_LEDS + 1];
CRGB left_screen[ 257];
CRGB button_leds[ 260];
CRGB right_screen[ 257];

int rrr, amt1;
int in1;
int lerp1;
int type, note, velocity, channel, d1, d2, color1, bright1;
byte ins[12];
int lerp[20];
float  xlow[3], xhigh[3];
int ylow, yhigh;
byte txtc, numc, button_gradient, button_color, button_sat, button_glitch;
int ns;
int score[4], text_select[4], number_select[4];
byte rh1 = 9;
byte rl1 = 2;

byte d13 = 1;;

byte restb = 40;
void setup() {

  pinMode(13, OUTPUT);
  //Serial.begin(9600);
  MIDI.begin(0);
  FastLED.addLeds<CHIPSET, 3, COLOR_ORDER>(button_leds, NUM_LEDS).setCorrection(TypicalSMD5050);
  FastLED.addLeds<CHIPSET, 5, COLOR_ORDER>(left_screen, NUM_LEDS).setCorrection(TypicalSMD5050);
  FastLED.addLeds<CHIPSET, 7, COLOR_ORDER>(right_screen, NUM_LEDS).setCorrection(TypicalSMD5050);



  FastLED.setBrightness( 255 );

  xlow[1] = 8;
  xhigh[1] = 24;

  ylow = 1;
  yhigh = 6;

  delay(100);
  int st;
  byte g;
  while (st < 20) {
    st++;
    for (int j = 0; j < 12; j++) {
      g += 2;
      for (int h = 0; h < 21; h++) {
        button_leds[j + (h * 12)].setHSV(g + (j * random(15, 23)), random(100, 255), 128);

      }
    }
    for (int j = 0; j < NUM_LEDS; j++) {
      g++;
      right_screen[j].setHSV(g + j / 8, 255 - (((j * 2) + g)), 255 + (((j * 4) + g)));
      left_screen[j].setHSV(j ^ g, 200, (j | g) % 128);

    }
    FastLED.show();
    Serial.println(st);

    delay(20);
  }
  Serial.println("|");

  xlow[1] = random(rl1, rh1);
  xhigh[1] = 28 - xlow[1];

  xlow[2] = random(rl1, rh1);
  xhigh[2] = 28 - xlow[2];

  /*
    for (int ledw = 0; ledw < BUTT_NUM; ledw++) {

      byte led_sat = 255;
      if (ledw == 4) {
        led_sat = 0;
      }

      for (int j = 0; j < 12; j++) {
        button_led_output[0][j] = restb;
        button_left_screen[(ledw * 12) + j] = CHSV(ledw * 28, led_sat, button_led_output[0][j]);
        left_screen[(ledw * 12) + (9 * 12) + j] = CHSV(ledw * 28, led_sat, button_led_output[1][ledw]);
      }
    }

    FastLED.show();
      delay(100);
  */
}


void loop()
{
  cm = millis();

  //in1=abs(analogRead(A0)-512)/2;
  //int raw1 = analogRead(A0);
  // in1 = abs(raw1 - 256) * 2;

  if (MIDI.read()) {
    byte type = MIDI.getType();
    //  Serial.println(type);

    if (type == 176) {  //cc
      d1 = MIDI.getData1();

      d2 = MIDI.getData2();
      byte ch = MIDI.getChannel();

      if (ch == 1) {
        text_select[1] = number_select[1] = score[1] = d2;
        mode[1] = d1;


      }

      if (ch == 2) {
        text_select[2] = number_select[2] = score[2] = d2;
        mode[2] = d1;

      }

    }

    if (type == 128) {  //note on
      d1 = MIDI.getData1();
      d2 = MIDI.getData2();
      byte ch = MIDI.getChannel();


      if (ch != 3) {
        d13 = 0;

        Serial.print("d1 ");      Serial.print(d1); Serial.print("  ");
        Serial.print("d2 ");     Serial.print(d2); Serial.print("  ");
        Serial.print("ch ");     Serial.println(ch);

        ylow = 1;
        yhigh = 6;
        button_sat = random(5) * 64;
        button_glitch = random(-2, 3);
        if (button_glitch < 0) {
          button_glitch = 0;
        }

        button_color = random(128);
        button_gradient = random(32);
      }

      if (ch == 1) {
        button_led_state[0][d1] = 255;
        button_led_output[0][d1] = 255;
        xlow[1] = random(rl1, rh1);
        xhigh[1] = 28 - xlow[1];
      }

      if (ch == 2) {
        button_led_state[1][d1] = 255;
        button_led_output[1][d1] = 255;
        xlow[2] = random(rl1, rh1);
        xhigh[2] = 28 - xlow[2];
      }



      if (ch == 3) {
        if (d1 == 0) {
          button_led_output[2][0] = 50;
          button_led_output[2][1] = 0;
          button_led_output[2][2] = 0;
        }
        if (d1 == 1) {
          button_led_output[2][0] = 0;
          button_led_output[2][1] = 50;
          button_led_output[2][2] = 0;
        }
        if (d1 == 2) {
          button_led_output[2][0] = 0;
          button_led_output[2][1] = 0;
          button_led_output[2][2] = 50;
        }



      }


    }

  }

  if (cm - prev[1] > 5 ) {
    prev[1] = cm;

    for (int ledw = 0; ledw < BUTT_NUM; ledw++) {

      byte led_sat = 255;
      if (ledw == 4) {
        led_sat = 0;
        //button_led_output[1][4] *= .9;
        //button_led_output[0][4] *= .9;
      }

      for (int j = 0; j < 12; j++) {
        button_leds[(ledw * 12) + j] = CHSV(ledw * 28, led_sat, button_led_output[0][ledw]);
        button_leds[(ledw * 12) + j + 108] = CHSV(ledw * 28, led_sat, button_led_output[1][ledw]);
        //left_screen[(ledw*12) + (9*12) + j] = CHSV(ledw * 28, led_sat, button_led_output[1][ledw]);
      }

      for (byte s = 0; s < 2; s++) {
        if (button_led_state[s][ledw] > 30) {
          button_led_state[s][ledw] -= 5;
          button_led_output[s][ledw] = curve[((button_led_state[s][ledw]))];  ;
          //button_led_output[0][ledw] -= 1;
          //button_led_output[ledw] = peak1_read;

          if (button_led_state[s][ledw] <= 30) {
            button_led_output[s][ledw] = 0;
            button_led_state[s][ledw] = 0;
          }
        }
      }
    }

    for (int j = 0; j < 12; j++) {
      button_leds[(18 * 12) + j] = CHSV(200, 200, button_led_output[2][0]);
      button_leds[(19 * 12) + j] = CHSV(100, 200, button_led_output[2][1]);
      button_leds[(20 * 12) + j] = CHSV(50 , 200, button_led_output[2][2]);
    }
  }



  if (cm - prev[3] > 50 ) {
    /*
          for (int bs = 0; bs < BUTT_NUM; bs++) {

            Serial.print(button_led_state[0][bs] );
            Serial.print( "_");
            Serial.print(button_led_output[0][bs]);
            Serial.print( "  ");


          }
          Serial.print( "   ");

          for (int bs = 0; bs < BUTT_NUM; bs++) {

            Serial.print(button_led_state[1][bs] );
            Serial.print( "_");
            Serial.print(button_led_output[1][bs]);
            Serial.print( "  ");


          }
          Serial.println( );
    */

    prev[3] = cm;
    float cut1 = 17;
    if (xlow[1] < cut1) {
      //xlow++;
      xlow[1] *= 1.22;
      xhigh[1] = 16 + (16 - xlow[1]);
    }
    if (xlow[2] < cut1) {
      //xlow++;
      xlow[2] *= 1.22;
      xhigh[2] = 16 + (16 - xlow[2]);
    }
    if (xlow[1] >= cut1) {
      xlow[1] = cut1;
    }
    if (xlow[2] > cut1) {
      xlow[2] = cut1;
    }
  }



  bright1 = lerper(0, d2, .95);
  color1 = lerper(0, d2, .95);


  if (cm - prev[2] > 40) {

    Serial.print(xlow[1]); Serial.print(" ");
    Serial.print(xlow[2]);
    Serial.println();
    digitalWrite(13, d13);

    prev[2] = cm;
    for ( byte y = 0; y < kMatrixHeight; y++) { //32
      for ( byte x = 0; x < kMatrixWidth; x++) { //8


        int br1 = DW((x + 1) * (y + 1), 255 + 25, 3) - 25;
        if (br1 < 0) {
          br1 = 0;
        }


        if (mode[1] == 0) {  //single number

          rrr = DW((x + 1) * (y + 1), 50, 4);
          left_screen[ XY(x, y)] = CHSV( rrr + 20, 255, 0);
          // right_screen[ XY(x, y)] = CHSV( rrr + 20, 255, 25 + rrr);

          if (y >= 12 && y < 20) {
            left_screen[ XY(x, y)]  = CHSV(  rrr + 20, 255, number[number_select[1]][x][y - 12] * 255);
            // right_screen[ XY(x, y)]  = CHSV(  rrr + 20, 255, number[number_select[2]][x][y - 12] * 255);
          }
        }

        if (mode[2] == 0) {  //single number

          rrr = DW((x + 1) * (y + 1), 50, 4);
          right_screen[ XY(x, y)] = CHSV( rrr + 20, 255, 0);

          if (y >= 12 && y < 20) {
            right_screen[ XY(x, y)]  = CHSV(  rrr + 20, 255, number[number_select[2]][x][y - 12] * 255);
          }
        }

        if (mode[1] == 1) { //score
          rrr = DW((x + 1) * (y + 1), 50, 2);
          number_output_left(score[1], x, y, ((score[1] * 4) + rrr) + (ns / 100));
        }

        if (mode[2] == 1) { //score
          rrr = DW((x + 1) * (y + 1), 50, 2);
          number_output_right(score[2], x, y, ((score[2] * 4) + rrr) + (ns / 100));
        }


        if (mode[1] == 2) { //text

          rrr = DW((x + 1) * (y + 1), 30, 1);
          byte tt1 = text_select[1];
          // Serial.println(tt1);
          if (tt1 == 14) {
            tt1 = 16;

          }
          left_screen[ XY(x, y)]  = CHSV( text_color[txtc] + rrr, 255 - (rrr / 3), text[tt1][x][y] * 255);
          // right_screen[ XY(x, y)]  = CHSV( text_color[txtc] + rrr, 255 - (rrr / 3), text[text_select[2]][x][y] * 255);

        }


        if (mode[2] == 2) { //text

          rrr = DW((x + 1) * (y + 1), 30, 1);

          right_screen[ XY(x, y)]  = CHSV( text_color[txtc] + rrr, 255 - (rrr / 3), text[text_select[2]][x][y] * 255);

        }

        if (mode[1] == 3) {   //visualizer

          left_screen[ XY(x, y)] = CHSV( rrr + 120, 50 + rrr, ( rrr / 2));
          right_screen[ XY(x, y)] = CHSV( rrr + 120, 50 + rrr, ( rrr / 2));

          for (int j = 2; j > -1; j--) {

            rrr = DW((x + 1) * (y + 1), 100, 0);

            if ( x > ylow + j && x < yhigh - j) {
              if (y >= xlow[1] - j && y <= xhigh[1] + j) {
                if (y >= xlow[1] - j && y < 16) {
                  left_screen[ XY(x, y)] = CHSV( button_color + ((y - kMatrixHeight / 2) * -button_gradient) + (rrr / 3) , 255 - button_sat, 170 - (j * 30) );

                }
                if (y <= xhigh[1] + j && y >= 16) {
                  left_screen[ XY(x, y)] = CHSV( button_color + (y * button_gradient) + (rrr / 3) , 255 - button_sat, 170 - (j * 30) );

                }
              }
            }

            if ( x > ylow + j && x < yhigh - j) {
              if (y >= xlow[2] - j && y <= xhigh[2] + j) {
                if (y >= xlow[2] - j && y < 16) {
                  right_screen[ XY(x, y)] = CHSV( button_color + ((y - kMatrixHeight / 2) * -button_gradient) + (rrr / 3) , 255 - button_sat, 170 - (j * 30) );

                }
                if (y <= xhigh[2] + j && y >= 16) {
                  right_screen[ XY(x, y)] = CHSV( button_color + (y * button_gradient) + (rrr / 3) , 255 - button_sat, 170 - (j * 30) );

                }
              }
            }
          }
        }
      }

    }
    FastLED.show();
    d13 = 1;
  }

}


void number_output_left(int input_number, byte x, byte y, byte num_color) {
  byte ones = (input_number % 10);
  byte tens = ((input_number / 10) % 10);
  byte hundreds = ((input_number / 100) % 10);

  left_screen[ XY(x, y)]  = CHSV( 0, 0, 0);

  if (y >= 8 && y < 16) {
    byte n0 = number[hundreds][x][y - 8];
    if (hundreds > 0) {
      left_screen[ XY(x, y)]  = CHSV( num_color, 200, 255 * n0);
    }
  }
  if (y >= 16 && y < 24) {
    byte n0 = number[tens][x][y - 16];

    if (input_number > 9 ) {
      left_screen[ XY(x, y)]  = CHSV( num_color, 200, 255 * n0);
    }
    if (hundreds > 0 ) {
      left_screen[ XY(x, y)]  = CHSV( num_color, 200, 255 * n0);
    }
    if (hundreds == 0 && input_number < 10 ) {
      left_screen[ XY(x, y)]  = CHSV( num_color, 200, 0);
    }
    if (input_number < 10) {
      left_screen[ XY(x, y)]  = CHSV( num_color, 200, 0);
    }

  }
  if (y >= 24) {
    byte n0 = number[ones][x][y - 24];
    left_screen[ XY(x, y)]  = CHSV( num_color, 200, 255 * n0);

  }

}

void number_output_right(int input_number, byte x, byte y, byte num_color) {
  byte ones = (input_number % 10);
  byte tens = ((input_number / 10) % 10);
  byte hundreds = ((input_number / 100) % 10);

  right_screen[ XY(x, y)]  = CHSV( 0, 0, 0);

  if (y >= 8 && y < 16) {
    byte n0 = number[hundreds][x][y - 8];
    if (hundreds > 0) {
      right_screen[ XY(x, y)]  = CHSV( num_color, 200, 255 * n0);
    }
  }
  if (y >= 16 && y < 24) {
    byte n0 = number[tens][x][y - 16];

    if (input_number > 9 ) {
      right_screen[ XY(x, y)]  = CHSV( num_color, 200, 255 * n0);
    }
    if (hundreds > 0 ) {
      right_screen[ XY(x, y)]  = CHSV( num_color, 200, 255 * n0);
    }
    if (hundreds == 0 && input_number < 10 ) {
      right_screen[ XY(x, y)]  = CHSV( num_color, 200, 0);
    }
    if (input_number < 10) {
      right_screen[ XY(x, y)]  = CHSV( num_color, 200, 0);
    }

  }
  if (y >= 24) {
    byte n0 = number[ones][x][y - 24];
    right_screen[ XY(x, y)]  = CHSV( num_color, 200, 255 * n0);

  }

}



byte DW(byte instance, byte highd, int timey) {
  static byte dwb[500];
  static byte dwr1[500];
  static byte dwtime[500];
  static byte max_step = 1;
  byte pdwb = dwb[instance];
  byte lock = 0;

  dwtime[instance]++;
  if (dwtime[instance] > timey) {
    if (dwb[instance] < dwr1[instance]) {
      dwb[instance] += max_step;
      lock = 1;
    }


    if (dwb[instance] > dwr1[instance] && lock == 0) {
      dwb[instance] -= max_step;
    }




    if (dwb[instance] == dwr1[instance]) {
      dwr1[instance] = random(highd);
    }

    if (pdwb > dwr1[instance] && dwb[instance] < dwr1[instance]) {
      dwr1[instance] = random(highd);
    }
    if (pdwb < dwr1[instance] && dwb[instance] > dwr1[instance]) {
      dwr1[instance] = random(highd);
    }

    if (dwb[instance] < 0) {
      dwb[instance] += max_step * 2;
      dwr1[instance] = random(highd);
    }

    if (dwb[instance] > highd) {
      dwb[instance] -= max_step * 2;
      dwr1[instance] = random(highd);
    }
    dwtime[instance] = 0;
  }

  return dwb[instance];
}


int lerper(byte instance, int input, float rate) {
  uint32_t cmm = millis();
  if (cm - lerpp[1] > 20) {
    lerpp[instance] = cm;
    lerp[instance] *= rate;
  }
  if (lerp[instance] < input) {
    lerp[instance] = input;
  }
  return lerp[instance];

}


uint16_t XY( uint8_t x, uint8_t y)
{
  uint16_t i;

  if ( kMatrixSerpentineLayout == false) {
    i = (y * kMatrixWidth) + x;
  }

  if ( kMatrixSerpentineLayout == true) {
    if ( y & 0x01) {
      // Odd rows run backwards
      uint8_t reverseX = (kMatrixWidth - 1) - x;
      i = (y * kMatrixWidth) + reverseX;
    } else {
      // Even rows run forwards
      i = (y * kMatrixWidth) + x;
    }
  }

  return i;
}

